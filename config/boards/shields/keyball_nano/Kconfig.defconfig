## config/boards/shields/keyball_nano/Kconfig.defconfig
```kconfig
if SHIELD_KEYBALL39_DONGLE

config ZMK_KEYBOARD_NAME
	default "Keyball39 Dongle"

# Transport-agnostic central role (ZMK 0.4). The dongle is the BLE split central.
config ZMK_SPLIT_ROLE_CENTRAL
	default y

config ZMK_SPLIT_BLE_CENTRAL_PERIPHERALS
	default 2

endif

if SHIELD_KEYBALL39_LEFT || SHIELD_KEYBALL39_RIGHT || SHIELD_KEYBALL39_DONGLE

config ZMK_SPLIT
	default y
	
endif

if ZMK_DISPLAY

choice ZMK_DISPLAY_WORK_QUEUE
    default ZMK_DISPLAY_WORK_QUEUE_DEDICATED
endchoice

endif

if LVGL

config LV_Z_VDB_SIZE
    default 64

config LV_DPI_DEF
    default 148

config LV_Z_BITS_PER_PIXEL
    default 1

choice LV_COLOR_DEPTH
    default LV_COLOR_DEPTH_1
endchoice

endif 
```
